## components/g6_brain/Kconfig
```kconfig
# G6 Brain Configuration — v1.0.0-beta7.1

menu "G6 Brain Configuration"

    menu "RLS Optimizer"

        config G6_RLS_LAMBDA_MIN
            int "Minimum RLS forgetting factor (x1000)"
            default 950
            range 900 999
            help
                Minimum effective forgetting factor for Variable Forgetting Factor.

        config G6_RLS_RIDGE_EPSILON
            int "RLS ridge regularization (x1e6)"
            default 10
            range 1 1000
            help
                Ridge term added to P-matrix diagonal (value × 1e-6). Prevents collapse.

        config G6_RLS_TRACE_MAX
            int "Maximum trace of P matrix"
            default 10000000
            range 100000 100000000
            help
                Upper limit for trace(P). Exceeding forces conservative/cold-start mode.

        config G6_RLS_VFF_SIGMA_SQ
            int "VFF sigma_sq tuning factor (x10000)"
            default 80
            range 10 200
            help
                Sigma squared used in Variable Forgetting Factor gradient.
    endmenu

    menu "Safety & Thermal"

        config G6_TEMP_CEILING
            int "Thermal ceiling temperature (°C)"
            default 70
            range 50 85
            help
                Hard ASIC temperature limit.

        config G6_TEMP_PROACTIVE_MARGIN
            int "ASIC proactive thermal margin below ceiling (°C)"
            default 5
            range 2 15
            help
                Degrees below G6_TEMP_CEILING at which proactive ASIC frequency and
                voltage step-back begins. Also defines the threshold at which upward
                slew is suspended to prevent oscillation at the thermal edge.
                Mirrors G6_VR_TEMP_PROACTIVE_MARGIN for the ASIC die.
        
        config G6_VR_TEMP_CEILING
            int "VR regulator thermal ceiling (°C)"
            default 85
            range 70 105
            help
                Hard thermal ceiling for the voltage regulator (vrTemp).
                When vrTemp reaches this value, both best_v and best_f are stepped
                back immediately to reduce total power through the VR.
                When vrTemp exceeds (ceiling - G6_VR_TEMP_PROACTIVE_MARGIN), only
                best_v is stepped back as an early warning response.
                Pass G6_VR_TEMP_NO_SENSOR (-1.0f) as vr_temp_c to g6_brain_update()
                to disable VR thermal monitoring entirely (no sensor available).

        config G6_VR_TEMP_PROACTIVE_MARGIN
            int "VR proactive thermal margin below ceiling (°C)"
            default 5
            range 2 15
            help
                Degrees below G6_VR_TEMP_CEILING at which proactive VR voltage
                step-back begins. A margin of 5°C means proactive action starts
                at (ceiling - 5). Only voltage is reduced in the proactive zone;
                frequency is only reduced at the hard ceiling.

        config G6_NER_THRESHOLD
            int "NER (nonce error rate) threshold (x100)"
            default 250
            range 50 2000
            help
                Nonce Error Rate threshold in 0.01% units.

        config G6_ENABLE_TEMP_PLAUSIBILITY
            bool "Enable optional temperature plausibility band (fail-closed)"
            default n
            help
                When enabled, finite-but-implausible ASIC/VR temperature readings
                outside [G6_TEMP_PLAUSIBILITY_MIN, G6_TEMP_PLAUSIBILITY_MAX] are
                routed fail-closed to the safety layer with G6_SAFETY_INPUT_RANGE.
                Catches stuck-low / stuck-high sensors (e.g. a -50 C reading that
                would otherwise be treated as a cold, healthy chip and allow the
                brain to train on a thermally-stressed ASIC). Default OFF: by
                default the brain validates temperature for finiteness only and
                trusts the integrator's telemetry layer for sensor health (see
                docs/SAFETY.md). The VR no-sensor sentinel (-1.0) is always exempt.

        config G6_TEMP_PLAUSIBILITY_MIN
            int "Minimum plausible temperature (C)"
            default 0
            range -40 40
            depends on G6_ENABLE_TEMP_PLAUSIBILITY
            help
                Lower bound of the optional temperature plausibility band.

        config G6_TEMP_PLAUSIBILITY_MAX
            int "Maximum plausible temperature (C)"
            default 120
            range 90 200
            depends on G6_ENABLE_TEMP_PLAUSIBILITY
            help
                Upper bound of the optional temperature plausibility band.
    endmenu

    menu "Optimization Behavior"

        config G6_DFS_STEP_MHZ
            int "DFS frequency step size (MHz)"
            default 25
            range 5 50
            help
                Step size used for optimization suggestions and slew limiting.
        
        config G6_ENABLE_EFFICIENCY_MODE
            bool "Enable true J/TH efficiency optimization"
            default n
            help
                When enabled, the brain uses a separate power RLS model + Dinkelbach-based
                J/TH optimizer to minimize Watts per TH/s.
        
        config G6_JTH_MAX_OUTER_ITERS
            int "Maximum outer iterations for J/TH Dinkelbach solver"
            default 7
            range 3 15
            help
                Maximum number of outer iterations in the Dinkelbach-based J/TH optimizer.
                Higher values may give slightly better results at the cost of more CPU time.

    endmenu

endmenu
```
